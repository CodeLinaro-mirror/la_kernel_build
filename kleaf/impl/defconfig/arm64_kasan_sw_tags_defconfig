## kleaf/impl/defconfig/arm64_kasan_sw_tags_defconfig
```kconfig
CONFIG_KASAN=y
CONFIG_KASAN_SW_TAGS=y
CONFIG_KASAN_OUTLINE=y
# CONFIG_KASAN_HW_TAGS is not set
CONFIG_FRAME_WARN=0

# TODO(b/359429865) Remove once our clang has https://github.com/llvm/llvm-project/pull/104826
# CONFIG_CFI_CLANG is not set
```

## kleaf/impl/defconfig/gcov_defconfig
```kconfig
CONFIG_GCOV_KERNEL=y
CONFIG_GCOV_PROFILE_ALL=y

# TODO(b/359429865) Remove once our clang has https://github.com/llvm/llvm-project/pull/104826
# CONFIG_CFI_CLANG is not set

# TODO(b/291710318) Allow section mismatch when using GCOV_PROFILE_ALL
#  modpost: vmlinux.o: section mismatch in reference: cpumask_andnot (section: .text) -> efi_systab_phys (section: .init.data)
CONFIG_SECTION_MISMATCH_WARN_ONLY=y
```
